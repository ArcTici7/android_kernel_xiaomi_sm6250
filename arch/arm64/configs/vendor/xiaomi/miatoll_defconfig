## arch/arm64/configs/vendor/xiaomi/miatoll_defconfig
```kconfig
# =========================
# BASIC KERNEL / BUILD STABILITY
# =========================
CONFIG_HOTPLUG_SIZE_BITS=29
CONFIG_TOOLS_SUPPORT_RELR=y
CONFIG_AUDIT=y
# CONFIG_AUDITSYSCALL is not set

# =========================
# TIMERS / SCHEDULER (LOW LATENCY BASE)
# =========================
CONFIG_NO_HZ=y
CONFIG_HIGH_RES_TIMERS=y
CONFIG_IRQ_TIME_ACCOUNTING=y

CONFIG_SCHED_WALT=y
CONFIG_TASKSTATS=y
CONFIG_TASK_XACCT=y
CONFIG_TASK_IO_ACCOUNTING=y
CONFIG_PSI=y

CONFIG_RCU_EXPERT=y
CONFIG_RCU_FAST_NO_HZ=y
CONFIG_RCU_NOCB_CPU=y

CONFIG_SCHED_TUNE=y
CONFIG_DEFAULT_USE_ENERGY_AWARE=y

CONFIG_PREEMPT=y
# CONFIG_PREEMPT_VOLUNTARY is not set
# CONFIG_PREEMPT_RT_FULL is not set

CONFIG_HZ_1000=y

# =========================
# DEBUG / TRACE SUPPORT
# =========================
CONFIG_IKCONFIG=y
CONFIG_IKCONFIG_PROC=y
CONFIG_IKHEADERS=y
CONFIG_LOG_BUF_SHIFT=20

# =========================
# CGROUPS (ANDROID COMPAT)
# =========================
CONFIG_CGROUPS=y
CONFIG_BLK_CGROUP=y
CONFIG_CGROUP_SCHED=y
CONFIG_CGROUP_FREEZER=y
CONFIG_CPUSETS=y
CONFIG_CGROUP_CPUACCT=y
CONFIG_CGROUP_BPF=y

CONFIG_NAMESPACES=y
# CONFIG_PID_NS is not set

# =========================
# SECURITY / HARDENING
# =========================
CONFIG_SLAB_FREELIST_RANDOM=y
CONFIG_SLAB_FREELIST_HARDENED=y
CONFIG_JUMP_LABEL=y
CONFIG_CC_STACKPROTECTOR_STRONG=y

CONFIG_KALLSYMS_ALL=y

CONFIG_BPF_SYSCALL=y
CONFIG_BPF_JIT_ALWAYS_ON=y

CONFIG_MODULES=y
CONFIG_MODULE_UNLOAD=y
CONFIG_MODVERSIONS=y

# =========================
# STORAGE / BLOCK
# =========================
CONFIG_BLK_INLINE_ENCRYPTION=y
CONFIG_BLK_INLINE_ENCRYPTION_FALLBACK=y

# =========================
# ARCH (SM6250 / QCOM)
# =========================
CONFIG_ARCH_QCOM=y
CONFIG_ARCH_ATOLL=y
CONFIG_ARCH_SDMMAGPIE=y

CONFIG_ARM64_VHE=y
CONFIG_ARM64_PAN=y

# =========================
# MEMORY / PERFORMANCE
# =========================
CONFIG_EMBEDDED=y
CONFIG_CMA=y
CONFIG_ZSMALLOC=y

CONFIG_RANDOMIZE_BASE=y

# =========================
# CPU / POWER
# =========================
CONFIG_CPU_IDLE=y
CONFIG_CPU_FREQ=y
CONFIG_CPU_FREQ_GOV_SCHEDUTIL=y

# =========================
# USB GADGET / UAC2
# =========================
CONFIG_USB_GADGET=y
CONFIG_USB_CONFIGFS=y
CONFIG_USB_CONFIGFS_F_UAC2=y
CONFIG_USB_CONFIGFS_F_AUDIO_SRC=y

CONFIG_USB_DWC3=y
CONFIG_USB_DWC3_MSM=y

# =========================
# ALSA / AUDIO
# =========================
CONFIG_SND=y
CONFIG_SND_DYNAMIC_MINORS=y
CONFIG_SND_USB_AUDIO=y
CONFIG_SND_PCM_TIMER=y
CONFIG_SND_HRTIMER=y

# =========================
# DO NOT ENABLE (IMPORTANT)
# =========================
# CONFIG_PREEMPT_VOLUNTARY is not set
# CONFIG_PREEMPT_RT_FULL is not set
# CONFIG_RT_GROUP_SCHED is not set

# DO NOT FORCE (ARM64 SAFETY)
# CONFIG_ARM64_LSE_ATOMICS is not set
# CONFIG_ARM64_LSE_ATOMICS_INSN is not set
```
